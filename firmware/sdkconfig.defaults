## works/table-tennis/smart-paddle/firmware/main/Kconfig.projbuild
```kconfig
menu "示例配置"

    config ESP_WIFI_SSID
        string "WiFi SSID"
        default "myssid"
        help
            SSID (网络名称)，示例将连接到此网络。

    config ESP_WIFI_PASSWORD
        string "WiFi 密码"
        default "mypassword"
        help
            示例使用的 WiFi 密码 (WPA 或 WPA2)。
    config ESP_WIFI_CHANNEL
        int "WiFi 信道"
        range 1 13
        default 1
        help
            示例使用的 WiFi 信道 (网络信道)。

    config ESP_MAX_STA_CONN
        int "最大站点连接数"
        default 4
        help
            连接到 AP 的最大站点数量。
endmenu
```
